## Kconfig
```kconfig
menuconfig L1_MIDDLEWARE_PACKAGE_01_UMCN_USING_UMCN
    bool "ENABLE: L1_MIDDLEWARE_PACKAGE_01_UMCN_USING_UMCN"
    default n
    help
        Enable uMCN package and compile sources in this folder.

    if L1_MIDDLEWARE_PACKAGE_01_UMCN_USING_UMCN

        config UMCN_USING_CMD
            bool "Enable uMCN command support (cmd_mcn.c)"
            default n
            help
                Build cmd_mcn.c and enable command related features.

        config UMCN_USING_DEMO
            bool "Enable uMCN demo examples"
            default n
            help
                Build examples under examples/ when selected.

    endif
```
